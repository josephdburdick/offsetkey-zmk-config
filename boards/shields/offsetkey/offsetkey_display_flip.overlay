/*
 * Rotate the dongle OLED 180 degrees for an upside-down mount.
 * The base overlay sets segment-remap + com-invdir; clearing both flips
 * the SH1106 scan in both axes. segment-offset = 2 still centers the
 * 128-column panel in the 132-column RAM either way.
 */
&oled {
    /delete-property/ segment-remap;
    /delete-property/ com-invdir;
};
